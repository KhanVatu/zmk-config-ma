## config/boards/shields/Kconfig.defconfig
```kconfig
if SHIELD_MAL

# Name must be less than 16 characters long!
config ZMK_KEYBOARD_NAME
    default "mal"

config ZMK_SPLIT_ROLE_CENTRAL
    default y

endif

if MAL || MAR

config ZMK_SPLIT
    default y

endif
```

## config/boards/shields/Kconfig.shield
```kconfig
# No whitespace after the comma or in your part name!
config MAL
    def_bool $(shields_list_contains,mal)

# No whitespace after the comma or in your part name!
config MAR
    def_bool $(shields_list_contains,mar)
```

## config/west.yml
```yaml
manifest:
  remotes:
    - name: zmkfirmware
      url-base: https://github.com/zmkfirmware
    - name: modul
      url-base: https://github.com/KhanVatu/My-shiel-module.git
    # Additional modules containing boards/shields/custom code can be listed here as well
    # See https://docs.zephyrproject.org/3.2.0/develop/west/manifest.html#projects
  projects:
    - name: zmk
      remote: zmkfirmware
      revision: main
      import: app/west.yml
    - name: mnew
      remote: modul
      revision: main
  self:
    path: config
```
